## sw/br/Config.in
```kconfig
source "$BR2_EXTERNAL_OVERLAY_PKGS_PATH/package/Config.in"
source "$BR2_EXTERNAL_OVERLAY_PKGS_PATH/package/Config.in.host"
```

## sw/br/board/artix35/uboot.its
```
/dts-v1/;
/ {
    description = "U-Boot";
    #address-cells = <1>;
    images {
	uboot {
	    description = "U-Boot";
	    data = /incbin/("u-boot.bin");
	    type = "standalone";
	    arch = "arm";
	    os = "U-Boot";
	    compression = "none";
	    load = <${UBOOT_ENTRY}>;
	    entry = <${UBOOT_ENTRY}>;
	    hash {
		algo = "crc32";
	    };
	};
    };
    configurations {
	default = "conf";
	conf {
	    description = "U-Boot";
	    loadables = "uboot";
	};
    };
};
```

## sw/br/configs/artix35_defconfig
```kconfig
BR2_microblazeel=y
BR2_KERNEL_HEADERS_6_6=y
BR2_GCC_VERSION_13_X=y
BR2_TOOLCHAIN_BUILDROOT_CXX=y
BR2_GCC_ENABLE_GRAPHITE=y
BR2_JLEVEL=20
BR2_TARGET_GENERIC_HOSTNAME="artix35"
BR2_TARGET_GENERIC_ROOT_PASSWD="1"
BR2_TARGET_GENERIC_GETTY_PORT="ttyUL0"
BR2_SYSTEM_DHCP="eth0"
BR2_ROOTFS_USERS_TABLES="$(BR2_EXTERNAL_OVERLAY_PKGS_PATH)/board/$(BR2_TARGET_GENERIC_HOSTNAME)/users.txt"
BR2_ROOTFS_OVERLAY="$(BR2_EXTERNAL_OVERLAY_PKGS_PATH)/board/$(BR2_TARGET_GENERIC_HOSTNAME)/rootfs-overlay"
BR2_ROOTFS_PRE_BUILD_SCRIPT="$(BR2_EXTERNAL_OVERLAY_PKGS_PATH)/board/$(BR2_TARGET_GENERIC_HOSTNAME)/pre-build.sh"
BR2_ROOTFS_POST_BUILD_SCRIPT="$(BR2_EXTERNAL_OVERLAY_PKGS_PATH)/board/$(BR2_TARGET_GENERIC_HOSTNAME)/post-build.sh"
BR2_ROOTFS_POST_IMAGE_SCRIPT="$(BR2_EXTERNAL_OVERLAY_PKGS_PATH)/board/$(BR2_TARGET_GENERIC_HOSTNAME)/post-image.sh"
BR2_ROOTFS_POST_SCRIPT_ARGS="$(BR2_DEFCONFIG)"
BR2_LINUX_KERNEL=y
BR2_LINUX_KERNEL_CUSTOM_TARBALL=y
BR2_LINUX_KERNEL_CUSTOM_TARBALL_LOCATION="$(call github,Xilinx,linux-xlnx,xlnx_rebase_v6.6_LTS)/xlnx_rebase_v6.6_LTS.tar.gz"
BR2_LINUX_KERNEL_USE_CUSTOM_CONFIG=y
BR2_LINUX_KERNEL_CUSTOM_CONFIG_FILE="$(BR2_EXTERNAL_OVERLAY_PKGS_PATH)/board/$(BR2_TARGET_GENERIC_HOSTNAME)/kernel.config"
BR2_LINUX_KERNEL_LINUX_BIN=y
BR2_LINUX_KERNEL_LZMA=y
BR2_LINUX_KERNEL_NEEDS_HOST_OPENSSL=y
BR2_PACKAGE_BUSYBOX_SHOW_OTHERS=y
BR2_PACKAGE_HAVEGED=y
BR2_TARGET_ROOTFS_CPIO=y
BR2_TARGET_ROOTFS_CPIO_LZMA=y
BR2_TARGET_ROOTFS_CPIO_UIMAGE=y
# BR2_TARGET_ROOTFS_TAR is not set
BR2_TARGET_UBOOT=y
BR2_TARGET_UBOOT_BUILD_SYSTEM_KCONFIG=y
BR2_TARGET_UBOOT_CUSTOM_TARBALL=y
BR2_TARGET_UBOOT_CUSTOM_TARBALL_LOCATION="$(call github,Xilinx,u-boot-xlnx,xlnx_rebase_v2024.01_2024.2)/xlnx_rebase_v2024.01_2024.2.tar.gz"
BR2_TARGET_UBOOT_USE_CUSTOM_CONFIG=y
BR2_TARGET_UBOOT_CUSTOM_CONFIG_FILE="$(BR2_EXTERNAL_OVERLAY_PKGS_PATH)/board/$(BR2_TARGET_GENERIC_HOSTNAME)/uboot.config"
BR2_TARGET_UBOOT_NEEDS_DTC=y
BR2_TARGET_UBOOT_NEEDS_OPENSSL=y
BR2_TARGET_UBOOT_NEEDS_GNUTLS=y
BR2_TARGET_UBOOT_FORMAT_REMAKE_ELF=y
BR2_TARGET_UBOOT_SPL=y
BR2_TARGET_UBOOT_CUSTOM_DTS_PATH="$(BR2_EXTERNAL_OVERLAY_PKGS_PATH)/board/$(BR2_TARGET_GENERIC_HOSTNAME)/hw-spec/devicetree.dts"
BR2_PACKAGE_HOST_BOOTGEN=y
BR2_PACKAGE_HOST_DOSFSTOOLS=y
BR2_PACKAGE_HOST_E2FSPROGS=y
BR2_PACKAGE_HOST_GENEXT2FS=y
BR2_PACKAGE_HOST_GENIMAGE=y
BR2_PACKAGE_HOST_MTOOLS=y
BR2_PACKAGE_HOST_QEMU=y
BR2_PACKAGE_HOST_QEMU_SYSTEM_MODE=y
BR2_PACKAGE_HOST_UBOOT_TOOLS_FIT_SUPPORT=y
BR2_PACKAGE_HOST_UBOOT_TOOLS_FIT_SIGNATURE_SUPPORT=y
BR2_PACKAGE_SERIAS_XLNX_CHIP_MICROBLAZE=y
BR2_PACKAGE_XLNX_HW_PRJ="$(PWD)/hw/prj_hw/artix"
BR2_PACKAGE_HOST_DEVICE_TREE_XLNX=y
BR2_PACKAGE_DEVICETREE_XLNX_TO_BLOB=y
BR2_PACKAGE_DEVICETREE_XLNX_EN_OVERLAY=y
```

## sw/br/package/Config.in
```kconfig
menu "Target external package"

menu "Libraries"



endmenu # "Libraries"

menu "Kernel modules"

source "$BR2_EXTERNAL_OVERLAY_PKGS_PATH/package/cma_dma_pl/Config.in"

endmenu # "Kernel modules"

menu "Applications"

source "$BR2_EXTERNAL_OVERLAY_PKGS_PATH/package/xvc-server/Config.in"
source "$BR2_EXTERNAL_OVERLAY_PKGS_PATH/package/xadc-lnx/Config.in"
source "$BR2_EXTERNAL_OVERLAY_PKGS_PATH/package/udevmem/Config.in"

endmenu # "Applications"

endmenu # "Target external package"
```

## sw/br/package/Config.in.host
```kconfig
menu "Host target package"

menu "Xilinx tools"

config BR2_PACKAGE_XLNX_TOOLS_VERSION
    string "Version Xilinx Tools"
    default "2019.1"

choice
    prompt "Target chip series"
    default BR2_PACKAGE_SERIAS_XLNX_CHIP_ZYNQ

config BR2_PACKAGE_SERIAS_XLNX_CHIP_ZYNQ
    bool "Zynq-7000"

config BR2_PACKAGE_SERIAS_XLNX_CHIP_ZYNQMP
    bool "Zynq UltraScale+ MPSoC"

config BR2_PACKAGE_SERIAS_XLNX_CHIP_MICROBLAZE
    bool "Microblaze"

endchoice # "Target chip series"

menu "Xilinx hardware"

config BR2_PACKAGE_XLNX_TOOLS_HW
    string "Path to vivado"
    default "$(XLNX19_HW)"

config BR2_PACKAGE_XLNX_HW_PRJ
    string "path project vivado"
    default "$(PWD)/hw/prj_hw/qmtech_lnx"

config BR2_PACKAGE_XLNX_HW_BD
    string "path source block design"
    default "$(PWD)/hw/src/bd"

# source "$BR2_EXTERNAL_OVERLAY_PKGS_PATH/package/embeddedhw-xlnx/Config.in"

endmenu # "Xilinx hardware"

menu "Xilinx Software"

config BR2_PACKAGE_XLNX_TOOLS_SW
    string "Path to xsct"
     default "$(XLNX19_SW)"

config BR2_PACKAGE_XLNX_HW_SPECIFIED
    string "Path to hardware specification (*.hdf or *.xsa)"
    default "$(BR2_EXTERNAL_OVERLAY_PKGS_PATH)/board/$(BR2_TARGET_GENERIC_HOSTNAME)/hw-spec"

source "$BR2_EXTERNAL_OVERLAY_PKGS_PATH/package/device-tree-xlnx/Config.in.host"
source "$BR2_EXTERNAL_OVERLAY_PKGS_PATH/package/embeddedsw-xlnx/Config.in.host"

endmenu # "Xilinx Software"

endmenu # "Xilinx tools"

# source "$BR2_EXTERNAL_OVERLAY_PKGS_PATH/package/zynq-mkbootimage/Config.in.host"

endmenu # "Host target package"
```

## sw/br/package/cma_dma_pl/Config.in
```kconfig
menuconfig BR2_PACKAGE_CMA_DMA_PL
  bool "cma-dma-pl driver"
  depends on BR2_LINUX_KERNEL
  help
    Linux kernel driver for CMA DMA PL.
    This driver provides DMA functionality for PL fabric in Xilinx Zynq devices.

if BR2_PACKAGE_CMA_DMA_PL

config BR2_PACKAGE_VER_CMA_DMA_PL
  string "version cma driver"
  default "0.1.0"

config BR2_PACKAGE_DEAMON_CMA_DMA_PL
  bool "deamon cma-dma-pl driver"
  help
    Linux kernel driver for CMA DMA PL.
    This driver provides DMA functionality for PL fabric in Xilinx Zynq devices.

endif
```

## sw/br/package/device-tree-xlnx/Config.in.host
```kconfig
menuconfig BR2_PACKAGE_HOST_DEVICE_TREE_XLNX
    bool "host Xilinx device-tree-xlnx repository"
    help
        Download and generate device trees using Xilinx tools.

if BR2_PACKAGE_HOST_DEVICE_TREE_XLNX

config BR2_PACKAGE_VER_DEVICETREE_XLNX
    string "device-tree-xlnx git version"
    default "xilinx_v2023.2"
    help
        Version git repository

config BR2_PACKAGE_DEVICETREE_XLNX_TO_BLOB
    bool "build device-tree to dtb"

config BR2_PACKAGE_DEVICETREE_XLNX_EN_OVERLAY
    bool "device-tree overlay"

if BR2_PACKAGE_DEVICETREE_XLNX_EN_OVERLAY

config BR2_PACKAGE_DEVICETREE_XLNX_OVERLAY
    string "path device-tree overlay"
    default "$(BR2_PACKAGE_XLNX_HW_SPECIFIED)/user-top.dts"

endif # BR2_PACKAGE_DEVICETREE_XLNX_EN_OVERLAY

endif # BR2_PACKAGE_HOST_DEVICE_TREE_XLNX
```

## sw/br/package/embeddedhw-xlnx/Config.in
```kconfig
config BR2_PACKAGE_EMBEDDEDHW_XLNX
    bool "Xilinx embeddedhw recovery project Vivado"
    depends on BR2_PACKAGE_XILINX_TOOLS
    help
        Recovery project Vivado
```

## sw/br/package/embeddedsw-xlnx/Config.in.host
```kconfig
config BR2_PACKAGE_HOST_EMBEDDEDSW_XLNX
    bool "host Xilinx embeddedsw repository"
    help
        Download and generate baremetal app fsbl or pmufw using Xilinx tools.

if BR2_PACKAGE_HOST_EMBEDDEDSW_XLNX

config BR2_PACKAGE_VER_EMBEDDEDSW_XLNX
    string "embeddedsw git version"
    default "xilinx_v2023.2"

endif # BR2_PACKAGE_HOST_EMBEDDEDSW_XLNX
```

## sw/br/package/irq_pl/Config.in
```kconfig
config BR2_PACKAGE_IRQ_PL
    bool "irq_f2p handlers driver"
    depends on BR2_LINUX_KERNEL
```

## sw/br/package/xadc-lnx/Config.in
```kconfig
config BR2_PACKAGE_XADC_LNX
	bool "XADC monitor"
	depends on BR2_arm && BR2_cortex_a9
	depends on BR2_LINUX_KERNEL
	help
		Application on Linux for programming other FPGA or debug insert FPGA using Ethernet
if BR2_PACKAGE_XADC_LNX

config BR2_PACKAGE_XADC_LNX_PTH_DEVICE
	string "path device to iio"
	default "/sys/bus/iio/devices/iio:device0"

endif # BR2_PACKAGE_XADC_LNX
```

## sw/br/package/xvc-server/Config.in
```kconfig
config BR2_PACKAGE_XVC_SERVER
	bool "xilinx virtual cable server"
	depends on BR2_arm && BR2_cortex_a9
	depends on BR2_LINUX_KERNEL
```

## sw/br/package/zynq-mkbootimage/Config.in.host
```kconfig
config BR2_PACKAGE_HOST_ZYNQ_MKBOOTIMAGE
	bool "host zynq-mkbootimage"
 	select BR2_PACKAGE_HOST_ELFUTILS
	help
	  This is an open-source replacement for the Xilinx bootgen application.
	  https://github.com/antmicro/zynq-mkbootimage
```
