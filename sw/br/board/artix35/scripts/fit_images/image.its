## sw/br/board/artix35/scripts/fit_images/image.its
```
/dts-v1/;
/ {
description = "buildroot fitimage";
#address-cells = <1>;
images {
		kernel-1 {
			description = "Linux Kernel";
			data = /incbin/("linux.bin");
			type = "kernel";
			arch = "arm";
			os = "linux";
			compression = "none";
			load = <0x8000>;
			entry = <0x8000>;
			hash-1 {
				algo = "sha1";
			};
		};
		fdt-1 {
			description = "Flattened Device Tree blob";
			data = /incbin/("devicetree.dtb");
			type = "flat_dt";
			arch = "arm";
			compression = "none";
			hash-1 {
				algo = "sha1";
			};
		};
		ramdisk-1 {
			description = "ramdisk";
			data = /incbin/("rootfs.cpio.lzma");
			type = "ramdisk";
			arch = "arm";
			os="linux";
			compression = "none";
			hash-1 {
				algo = "sha1";
			};
		};
	};
	configurations {
		default = "conf-1";
		conf-1 {
			description = "Boot Linux kernel with FDT blob+ramdisk";
			kernel = "kernel-1";
			fdt = "fdt-1";
			ramdisk="ramdisk-1";
		};
	};
};
```

## sw/br/board/artix35/scripts/fit_images/kernel.its
```
/dts-v1/;
/ {
    description = "Linux Kernel Image for Zynq-7000";
    #address-cells = <1>;
    images {
        kernel {
            description = "Linux Kernel";
            data = /incbin/("zImage");
            type = "kernel";
            arch = "arm";
            os = "linux";
            compression = "none";
            load = <0x8000>;
            entry = <0x8000>;
            hash {
                algo = "sha1";
            };
        };
    };
    configurations {
        default = "conf";
        conf {
            description = "Boot Linux kernel only";
            kernel = "kernel";
        };
    };
};
```

## sw/br/board/artix35/scripts/fit_images/rootfs.its
```
/dts-v1/;
/ {
    description = "Root Filesystem for Zynq-7000";
    #address-cells = <1>;
    images {
        ramdisk {
            description = "Root Filesystem";
            data = /incbin/("rootfs.cpio.lzma");
            type = "ramdisk";
            arch = "arm";
            os = "linux";
            compression = "lzma";
            hash {
                algo = "sha1";
            };
        };
    };
    configurations {
        default = "conf";
        conf {
            description = "Root filesystem only";
            ramdisk = "ramdisk";
        };
    };
};
```

## sw/br/package/udevmem/Config.in
```kconfig
config BR2_PACKAGE_UDEVMEM
	bool "udevmem"
	help
		Application on Linux for programming other FPGA or debug insert FPGA using Ethernet
```
